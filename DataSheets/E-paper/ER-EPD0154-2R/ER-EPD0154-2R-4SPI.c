//----------------------------------------------------------------------
/*EASTRISING TECHNOLOGY CO,.LTD.*/
// Module    : ER-EPD0154-2R  ER-EPD0154-2Y 1.54"   200*200 dots
// Create    : JAVEN
// Date      : 2019-03-25
// Drive IC  : ssd1681
// INTERFACE : 4line Serial 
// MCU 		 : STC12LE5A60S2
// VDD		 : 3.3V  
//----------------------------------------------------------------------

#include <reg52.h>
#include <intrins.h>
sbit 	BUSY=P3^0;
sbit 	RES=P3^1;
sbit 	DC=P3^3;
sbit 	CS1=P3^4;
sbit 	SCK=P3^5;
sbit 	SDA=P3^6;

sbit	int0=P3^2;

bit log=0;

#define uchar  unsigned char
#define uint  unsigned int


//xx Private macro xxxxxxxxxxxxxxxxxxxxxxxxxxxxxxxxxxxxxxxxxxxxxxxxxxxxxxxxxxxxxxxxxxxxxxxxxxxxxxxxxxxxxxxxxxxxxx

#define SDA_H     	(SDA=1)						
#define SDA_L     	(SDA=0)
#define SCLK_H    	(SCK=1)  					
#define SCLK_L   	(SCK=0) 
#define nCS_H     	(CS1=1)						
#define nCS_L     	(CS1=0)
#define nDC_H     	(DC=1)						
#define nDC_L     	(DC=0)
#define nRST_H     	(RES=1)						
#define nRST_L     	(RES=0)


#define DELAY_TIME	2									// DELAY TIME

#define MODE1  											// panel scan direction

unsigned char temp1,temp2;
unsigned char tempvalue;

#define PIC_RED		    253
#define PIC_BLACK		252
#define PIC_WHITE		255
#define PIC_A			1
#define PIC_B   	    2
#define PIC_C   	    3
#define PIC_HLINE		4
#define PIC_VLINE	    5
#define PIC_R			6
#define PIC_D   	    7
#define PIC_E		    8
#define PIC_F	        9


unsigned char temp1,temp2;
unsigned int tempcode;
unsigned char tempvalue;



const unsigned char code BW1[5000] = { /* 0X10,0X01,0X00,0XC8,0X00,0XC8, */
0XFF,0XFF,0XFF,0XFF,0XFF,0XFF,0XFF,0XFF,0XFF,0XFF,0XFF,0XFF,0XFF,0XFF,0XFF,0XFF,
0XFF,0XFF,0XFF,0XFF,0XFF,0XFF,0XFF,0XFF,0XFF,0XFF,0XFF,0XFF,0XFF,0XFF,0XFF,0XFF,
0XFF,0XFF,0XFF,0XFF,0XFF,0XFF,0XFF,0XFF,0XFF,0XFF,0XFF,0XFF,0XFF,0XFF,0XFF,0XFF,
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0XFF,0XFF,0XFF,0XFF,0XFF,0XFF,0XFF,0XFF,};
	
	
const unsigned char code RED1[5000] = {/* 0X10,0X01,0X00,0XC8,0X00,0XC8, */
0X00,0X00,0X00,0X00,0X00,0X00,0X00,0X00,0X00,0X00,0X00,0X00,0X00,0X00,0X00,0X00,
0X00,0X00,0X00,0X00,0X00,0X00,0X00,0X00,0X00,0X00,0X00,0X00,0X00,0X00,0X00,0X00,
0X00,0X00,0X00,0X00,0X00,0X00,0X00,0X00,0X00,0X00,0X00,0X00,0X00,0X00,0X00,0X00,
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0X00,0X00,0X00,0X00,0X00,0X00,0X00,0X00,};


//xxxxxxxxxxxxxxxxxxxxxxxxxxxxxxxxxxxxxxxxxxxxxxxxxxxxxxxxxxxxxxxxxxxxxxxxxxxxxxxxxxxxxxxxxxxxxxxxxxxxxxxxxxxxxxx
//xx   DESAY xxxxxxxxxxxxxxxxxxxxxxxxxxxxxxxxxxxxxxxxxxxxxxxxxxxxxxxxxxxxxxxxxxxxxxxxxxxxxxxxxxxxxxxxxxxxx
//xxxxxxxxxxxxxxxxxxxxxxxxxxxxxxxxxxxxxxxxxxxxxxxxxxxxxxxxxxxxxxxxxxxxxxxxxxxxxxxxxxxxxxxxxxxxxxxxxxxxxxxxxxxxxxx
void DELAY_100nS(int delaytime)   						// 30us 
{
	int i,j;
	
	for(i=0;i<delaytime;i++)
		for(j=0;j<1;j++);
}

void DELAY_mS(int delaytime)    						// 1ms
{
	int i,j;
	
	for(i=0;i<delaytime;i++)
		for(j=0;j<200;j++);
}

void DELAY_S(int delaytime)     						// 1s
{
	int i,j,k;
	
	for(i=0;i<delaytime;i++)
		for(j=0;j<1000;j++)
			for(k=0;k<200;k++);

				for(;log==1;);
}



// RESET xxxxxxxxxxxxxxxxxxxxxxxxxxxxxxxxxxxxxxxxxxxxxxxxxxxxxxxxxxxxxxxxxxxxxxxxxxxxxxxxxxxxxxxxxxxxxxxxxxxxx
void RESET()
{
	nRST_L;
	DELAY_mS(1);								
 	nRST_H;
  	DELAY_mS(1);
}

// READ BUSY xxxxxxxxxxxxxxxxxxxxxxxxxxxxxxxxxxxxxxxxxxxxxxxxxxxxxxxxxxxxxxxxxxxxxxxxxxxxxxxxxxxxxxxxxxxxxxxxx
void READBUSY()
{
  	while(1)
  	{
   		_nop_();
   	 	if(BUSY==0)
    		break;
  	}      
}

// WRITE COMMAND  xxxxxxxxxxxxxxxxxxx
void SPI4W_WRITECOM(unsigned char INIT_COM)
{
  	unsigned char TEMPCOM;
  	unsigned char scnt;

  	TEMPCOM=INIT_COM;
    	SCLK_H;  
 	nDC_L;
  	nCS_H;
  	nCS_L;
  	for(scnt=0;scnt<8;scnt++)
  	{
    	if(TEMPCOM&0x80)
     	 	SDA_H;
    	else
      		SDA_L;
    	SCLK_L;  
    	SCLK_H;  
    	TEMPCOM=TEMPCOM<<1;
  	}
  	nCS_H;  
}

// WRITE DATA  xxxxxxxxxxxxxxxxxxxxxxxxxxxxxxxxxxxxxxxxxxxxxxxxxxxxxxxxxxxxxxxxxxxxxxxxxxxxxxxxxxxxxxxxxxxxx
void SPI4W_WRITEDATA(unsigned char INIT_DATA)
{
  	unsigned char TEMPCOM;
  	unsigned char scnt;

  	TEMPCOM=INIT_DATA;
    	SCLK_H;  
 	nDC_H;
  	nCS_H;
  	nCS_L;
  	for(scnt=0;scnt<8;scnt++)
  	{
    	if(TEMPCOM&0x80)
     	 	SDA_H;
    	else
      		SDA_L;
    	SCLK_L;  
    	SCLK_H;  
    	TEMPCOM=TEMPCOM<<1;
  	}
  	nCS_H;  
}



// READ DATAxxxxxxxxxxxxxxxxxxxxxxxxxxxxxxxxxxxxxxxxxxxxxxxxxxxxxxxxxxxxxxxxxxxxxxxxxxxxxxxxxxxxxxxxxxxxxxxxxxxxxxx
 unsigned char SPI4W_READDATA1()
 {
	 unsigned char scnt,temp;
         temp=0;
   	nCS_L;        
	 nDC_H;
	 for(scnt=0;scnt<8;scnt++)
	 {
		 	  
		 SCLK_L;  
		 if(SDA)
		 temp=(temp<<1)|0x01;
		 else
		 temp=temp<<1;		
		 SCLK_H;	  
		 SCLK_L;  
	 }
         tempvalue= temp;

  	nCS_H; 

	 return temp;
 }




void INIT_SSD1681()
{  	
        
		SPI4W_WRITECOM(0x01);  // Set MUX as 199
        SPI4W_WRITEDATA(0xC7);           
        SPI4W_WRITEDATA(0x00);
        SPI4W_WRITEDATA(0x00);     
        
        SPI4W_WRITECOM(0x11);  // Data entry mode
        SPI4W_WRITEDATA(0x03);         
        SPI4W_WRITECOM(0x44); 
        SPI4W_WRITEDATA(0x00); // RAM x address start at 0
        SPI4W_WRITEDATA(0x18); //RAM x address end at 0Ch(24+1)*8->200
        SPI4W_WRITECOM(0x45); 
        SPI4W_WRITEDATA(0xC7); // RAM y address start at C7h;  
        SPI4W_WRITEDATA(0x00);
        SPI4W_WRITEDATA(0x00); // RAM y address end at 00h;
        SPI4W_WRITEDATA(0x00);
        
        
        SPI4W_WRITECOM(0x3C); // board
        SPI4W_WRITEDATA(0x01); // HIZ

        
 	
		SPI4W_WRITECOM(0x18);
	   	SPI4W_WRITEDATA(0X80);
	   	SPI4W_WRITECOM(0x22);
	   	SPI4W_WRITEDATA(0XB1);	//Load Temperature and waveform setting.
	   	SPI4W_WRITECOM(0x20);
		 nCS_H;  
	   	READBUSY();		   
   
	   
  	    SPI4W_WRITECOM(0x1B);
    	temp1=SPI4W_READDATA1(); 
    	temp2=SPI4W_READDATA1();
   		

}

// SELEEP xxxxxxxxxxxxxxxxxxxxxxxxxxxxxxxxxxxxxxxxxxxxxxxxxxxxxxxxxxxxxxxxxxxxxxxxxxxxxxxxxxxxxxxxxxxxxxxxxxx
void enterdeepsleep()
{
  
  	SPI4W_WRITECOM(0x10);
  	SPI4W_WRITEDATA(0x01);
	
																													
}


void set_xy_window(unsigned char xs,unsigned char xe,unsigned int ys,unsigned int ye)
{	 


	SPI4W_WRITECOM(0x44);		// set RAM x address start/end, in page 36
	SPI4W_WRITEDATA(xs);		// RAM x address start at 00h;
	SPI4W_WRITEDATA(xe);		// RAM x address end at 0fh(12+1)*8->104 
	SPI4W_WRITECOM(0x45);		// set RAM y address start/end, in page 37
	SPI4W_WRITEDATA(ys);		// RAM y address start at 0;
	SPI4W_WRITEDATA(ys>>8);		
    SPI4W_WRITEDATA(ye);		// RAM y address end at 
    SPI4W_WRITEDATA(ye>>8);		// RAM y address end at 
}


void set_xy_counter(unsigned char x,unsigned int y)
{ 
        SPI4W_WRITECOM(0x4E);		// set RAM x address count 
        SPI4W_WRITEDATA(x);
        SPI4W_WRITECOM(0x4F);		// set RAM y address count 	
        SPI4W_WRITEDATA(y);
        SPI4W_WRITEDATA(y>>8);
}

void Display_update(void)
{
     SPI4W_WRITECOM(0x22);
	SPI4W_WRITEDATA(0xF7);		// Display update
	SPI4W_WRITECOM(0x20);
	DELAY_mS(1);
	READBUSY();
}

void clear(void)
{ 	unsigned int row, col;
	
   set_xy_window(0, 24, 0, 199);
   set_xy_counter(0,0);
	SPI4W_WRITECOM(0x24);
	for(col=0; col<200; col++)							
	{
		for(row=0; row<25; row++)						
		{SPI4W_WRITEDATA(0xff);
		}
	 }
   set_xy_window(0, 24, 0, 199);
   set_xy_counter(0,0);
	SPI4W_WRITECOM(0x26);
	for(col=0; col<200; col++)							
	{
		for(row=0; row<25; row++)						
		{SPI4W_WRITEDATA(0x00);
		}
	}				
}


void dis_img(unsigned char num)
{
	unsigned int row, col;
	unsigned int pcnt;
/***************************************************bw image****************************************************/
   set_xy_window(0, 24, 0, 199);
   set_xy_counter(0,0);
	SPI4W_WRITECOM(0x24);
	
	pcnt = 0;											
	for(col=0; col<200; col++)							
	{
		for(row=0; row<25; row++)						
		{
				switch (num)
				{
				case PIC_A:
					
                   SPI4W_WRITEDATA(BW1[pcnt]);                                     
					break;	
                                                                            
 
 
 				case PIC_RED:
					SPI4W_WRITEDATA(0xff);
					break;	                                
					
				case PIC_WHITE:
					SPI4W_WRITEDATA(0xff);
					break;	

				case PIC_BLACK:
					SPI4W_WRITEDATA(0x00);
					break;	
			   	default:
					break;
				}
			pcnt++;
		}
	}

             
/***************************************************bw image****************************************************/
	set_xy_window(0, 24, 0, 199);
	set_xy_counter(0,0);
	SPI4W_WRITECOM(0x26);
	
	pcnt = 0;										
	for(col=0; col<200; col++)							
	{
		for(row=0; row<25; row++)					
		{
				switch (num)
				{
				case PIC_A:
				
                         SPI4W_WRITEDATA(RED1[pcnt]);
									break;	
 
 
                                       
 				case PIC_RED:
					SPI4W_WRITEDATA(0xff);
					break;	   

				case PIC_WHITE:
					SPI4W_WRITEDATA(0x00);
					break;	

				case PIC_BLACK:
					SPI4W_WRITEDATA(0x00);
					break;	
			   	default:
					break;
				}
			pcnt++;
		}
	}
        		
        
 Display_update();
	

}



 void dis_block(unsigned char xs,unsigned char xe,unsigned int ys,unsigned int ye, unsigned char dat, unsigned char mode)

  {	 
	unsigned int row, col;
	unsigned int pcnt;
/***************************************************bw image****************************************************/


  set_xy_window(xs, xe, ys, ye);

   set_xy_counter(xs,ye-ys);
	SPI4W_WRITECOM(0x24);
	
	pcnt = 0;										
	for(col=ys; col<=ye; col++)							
	{
		for(row=xs; row<=xe; row++)					
		{
			
					SPI4W_WRITEDATA(dat);

		}
			pcnt++;
		
	}



    set_xy_window(xs, xe, ys, ye);
    set_xy_counter(xs,ye-ys);
	SPI4W_WRITECOM(0x26);
	
	pcnt = 0;										
	for(col=ys; col<=ye; col++)						
	{
		for(row=xs; row<=xe; row++)					
		{
					 if(mode==0x26)
					SPI4W_WRITEDATA(dat);
					else
					SPI4W_WRITEDATA(0x00);
		}
			pcnt++;
		
	}


   Display_update();

  }



//xxxxxxxxxxxxxxxxxxxxxxxxxxxxxxxxxxxxxxxxxxxxxxxxxxxxxxxxxxxxxxxxxxxxxxxxxxxxxxxxxxxxxxxxxxxxxxxxxxxxxxxxxxxxxxx
//xx   main xxxxxxxxxxxxxxxxxxxxxxxxxxxxxxxxxxxxxxxxxxxxxxxxxxxxxxxxxxxxxxxxxxxxxxxxxxxxxxxxxxxxxxxxxxxxxxx
//xxxxxxxxxxxxxxxxxxxxxxxxxxxxxxxxxxxxxxxxxxxxxxxxxxxxxxxxxxxxxxxxxxxxxxxxxxxxxxxxxxxxxxxxxxxxxxxxxxxxxxxxxxxxxxx
void main( void )
{
	//int i;
        
		
	RESET();											
    	SPI4W_WRITECOM(0x12);			//SWRESET
	READBUSY();
	
	
	INIT_SSD1681();	
	 
	while(1)
	{

		 clear() ;
 	         
		dis_img(PIC_A);
		DELAY_S(3);

        SPI4W_WRITECOM(0x21);
        SPI4W_WRITEDATA(0x08); 

     	Display_update();
		DELAY_S(3);


        SPI4W_WRITECOM(0x21);
        SPI4W_WRITEDATA(0x00); 

     /*          
        dis_img(PIC_B);
		DELAY_S(3);
  

	     SPI4W_WRITECOM(0x21);
        SPI4W_WRITEDATA(0x08); 

     	Display_update();
		DELAY_S(3);


           SPI4W_WRITECOM(0x21);
        SPI4W_WRITEDATA(0x00); 


		dis_img(PIC_C);
		DELAY_S(3);
               
        SPI4W_WRITECOM(0x21);
        SPI4W_WRITEDATA(0x08); 

     	Display_update();
		DELAY_S(3);


           SPI4W_WRITECOM(0x21);
        SPI4W_WRITEDATA(0x00); 

 
 		dis_img(PIC_D);
		DELAY_S(3);
               
        SPI4W_WRITECOM(0x21);
        SPI4W_WRITEDATA(0x08); 

     	Display_update();
		DELAY_S(3);


           SPI4W_WRITECOM(0x21);
        SPI4W_WRITEDATA(0x00); 

 			  */
               
   
    	 dis_img(PIC_WHITE);
	 	DELAY_S(2);

 /* 
	
  	dis_img(PIC_BLACK);
         DELAY_S(2);

		 dis_block(4,9,0+5,40+5, 0xff, 0x24);
          DELAY_S(2);

		 dis_block(4,9,0+5,40+5, 0xff, 0x26);
          DELAY_S(2);

      	 dis_img(PIC_WHITE);
	 	DELAY_S(2);


		dis_block(0,4,0,40, 0x00, 0x24);
          DELAY_S(2);

		 dis_block(0,4,0,40, 0xff, 0x26);
          DELAY_S(2);	 */



		dis_img(PIC_RED);
		DELAY_S(2);

   		dis_block(2,6,20,60,  0x00, 0x24);
          DELAY_S(2);

		 dis_block(2,6,20,60, 0xff, 0x24);
          DELAY_S(2);

  


  
                        
	}

}
